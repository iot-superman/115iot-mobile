// PROGRAM : U2_1_2_INT0_PA6.c
// FUNCTION: Nest Interrupt Demo Program
//           INT0 改由 PA6 實現
// AUTHOR  : Steven + 修正版

#include <HT66F2390.h>
#include "MyType.H"

//==================================================
// LED PORT DEFINE
//==================================================
#define LEDPort     _pf
#define LEDPortC    _pfc

//==================================================
// 7-SEG DEFINE
//==================================================
#define SEGPort     _pg
#define SEGPortC    _pgc

//==================================================
// 7-Segment Table
//==================================================
const u8 SEG_TAB[] =
{
    0x3F,0x06,0x5B,0x4F,0x66,
    0x6D,0x7D,0x07,0x7F,0x67
};

//==================================================
// Function Prototype
//==================================================
void Delayms(u16 del);

//==================================================
// MAIN
//==================================================
void main()
{
    u8 i;

    //==============================================
    // 關閉 WDT
    //==============================================
    _wdtc = 0b10101111;

    //==============================================
    // LED PORT 初始化
    //
    // PF0~PF7:
    // 0 = LED ON
    // 1 = LED OFF
    //==============================================
    LEDPort  = 0xFF;
    LEDPortC = 0x00;

    //==============================================
    // 7-Segment 初始化
    //==============================================
    SEGPort  = 0x00;
    SEGPortC = 0x00;

    //==============================================
    // Pull-High Enable
    //
    // INT0 -> PA6
    // INT1 -> PA7
    //==============================================
    _papu6 = 1;          // ★修改：PA6 Pull-High
    _papu7 = 1;

    //==============================================
    // INT0 Pin Select
    //
    // 0 : PA1
    // 1 : PA6
    //==============================================
    _int0ps = 1;         // ★修改重點：INT0 改到 PA6

    //==============================================
    // INT1 Pin Select
    //
    // 0 : PA3
    // 1 : PA7
    //==============================================
    _int1ps = 1;

    //==============================================
    // Interrupt Edge Select
    //
    // INT1 -> bit3
    // INT0 -> bit1
    //
    // 1 = Falling Edge Trigger
    //==============================================
    _integ = 0b00001010;

    //==============================================
    // Enable Interrupt
    //==============================================
    _int0e = 1;
    _int1e = 1;
    _emi   = 1;

    //==============================================
    // MAIN LOOP
    //==============================================
    while(1)
    {
        for(i=0;i<10;i++)
        {
            //======================================
            // 顯示數字
            //======================================
            SEGPort = SEG_TAB[i];

            //======================================
            // 延遲 1 秒
            //======================================
            Delayms(1000);
        }
    }
}

//==================================================
// INT0 ISR
//
// INT0 -> PA6
//
// LED 左跑馬燈
//==================================================
DEFINE_ISR(ISR_Int0,0x04)
{
    u8 i,temp;

    //==============================================
    // 關閉 INT0
    // 避免按鍵彈跳
    //==============================================
    _int0e = 0;

    //==============================================
    // Enable Nested Interrupt
    //==============================================
    _emi = 1;

    //==============================================
    // 保存目前 LED 狀態
    //==============================================
    temp = LEDPort;

    //==============================================
    // PF0 亮
    //==============================================
    LEDPort = 0b11111110;

    //==============================================
    // 左跑馬燈
    //==============================================
    for(i=0;i<8;i++)
    {
        GCC_DELAY(250000);
        GCC_DELAY(250000);

        //==========================================
        // LED 左旋
        //==========================================
        GCC_RL(LEDPort);
    }

    //==============================================
    // 還原 LED 狀態
    //==============================================
    LEDPort = temp;

    //==============================================
    // 清除 INT0 Flag
    //==============================================
    _int0f = 0;

    //==============================================
    // 重新 Enable INT0
    //==============================================
    _int0e = 1;
}

//==================================================
// INT1 ISR
//
// INT1 -> PA7
//
// LED 右跑馬燈
//==================================================
DEFINE_ISR(ISR_Int1,0x08)
{
    u8 i,temp;

    //==============================================
    // 關閉 INT1
    //==============================================
    _int1e = 0;

    //==============================================
    // Enable Nested Interrupt
    //==============================================
    _emi = 1;

    //==============================================
    // 保存目前 LED 狀態
    //==============================================
    temp = LEDPort;

    //==============================================
    // PF7 亮
    //==============================================
    LEDPort = 0b01111111;

    //==============================================
    // 右跑馬燈
    //==============================================
    for(i=0;i<8;i++)
    {
        GCC_DELAY(250000);
        GCC_DELAY(250000);

        //==========================================
        // LED 右旋
        //==========================================
        GCC_RR(LEDPort);
    }

    //==============================================
    // 還原 LED 狀態
    //==============================================
    LEDPort = temp;

    //==============================================
    // 清除 INT1 Flag
    //==============================================
    _int1f = 0;

    //==============================================
    // 重新 Enable INT1
    //==============================================
    _int1e = 1;
}

//==================================================
// Delay Function
//==================================================
void Delayms(u16 del)
{
    u16 i;

    for(i=0;i<del;i++)
    {
        GCC_DELAY(2000);
    }
}