// PROGRAM : ADC Voltage Display with 4-Digit 7SEG
// MCU     : HT66F2390
// FUNCTION: ADC 轉換後直接顯示電壓值 (例如 3.30V)
// AUTHOR  : ChatGPT Modify
// 說明：
// 原本程式顯示 ADC Raw Value (0~4095)
// 現在改成直接顯示：
//      電壓值
// 例如：
//      3.30V → 顯示 330
//      1.25V → 顯示 125
//
// 假設：
//      ADC 參考電壓 Vref = 5.00V
//      ADC 解析度 = 12-bit = 4095
//
// 電壓公式：
//      Voltage = ADC * 5.00V / 4095 
//
// 為了避免浮點數造成 MCU 負擔：
//      改用整數運算
//
// 顯示方式：
//      0~500 → 表示 0.00V~5.00V
//
// 範例：
//      330 => 3.30V
//

#include <HT66F2390.h>
#include "MyType.h"

#define	 SEGPort	_pg
#define  SEGPortC	_pgc

#define	 ScanPort	_pe
#define	 ScanPortC	_pec

//----------------------------------------------------
// 七段顯示碼表 (共陰)
//----------------------------------------------------
const u8 SEG_TAB[] =
{
    0x3F, // 0
    0x06, // 1
    0x5B, // 2
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    0x7F, // 8
    0x6F  // 9
};

//----------------------------------------------------
// 全域變數
//----------------------------------------------------
volatile u8 *ptr;
volatile u8 ScanCode;
volatile u8 Buffer[4];

//----------------------------------------------------
// main
//----------------------------------------------------
void main()
{
    u16 adcValue;
    u16 voltage;

    //------------------------------------------------
    // 關閉 WatchDog
    //------------------------------------------------
    _wdtc = 0b10101111;

    //------------------------------------------------
    // 七段 Port 設定輸出
    //------------------------------------------------
    SEGPort = 0;
    SEGPortC = 0;

    //------------------------------------------------
    // 掃描腳位設定輸出
    //------------------------------------------------
    ScanPort &= 0xF0;
    ScanPortC &= 0xF0;

    //------------------------------------------------
    // Timer Base 設定
    //------------------------------------------------
    _psc0r = 0x01;
    _tb0c  = 0x85;
    _tb0e  = 1;

    //------------------------------------------------
    // ADC 設定
    //------------------------------------------------
    _sadc0 = 0b00111000; // AN8
    _sadc1 = 0x07;
    _sadc2 = 0x00;

    //------------------------------------------------
    // PD0 設定 AN8
    //------------------------------------------------
    _pds0 = 0x03;

    //------------------------------------------------
    // 初始值
    //------------------------------------------------
    ptr = Buffer;
    ScanCode = 0x01;

    Buffer[0] = 0;
    Buffer[1] = 0;
    Buffer[2] = 0;
    Buffer[3] = 0;

    //------------------------------------------------
    // 開啟總中斷
    //------------------------------------------------
    _emi = 1;

    //------------------------------------------------
    // 主迴圈
    //------------------------------------------------
    while(1)
    {
        //--------------------------------------------
        // 啟動 ADC
        //--------------------------------------------
        _start = 1;
        _start = 0;

        //--------------------------------------------
        // 等待 ADC 完成
        //--------------------------------------------
        while(_adbz);

        //--------------------------------------------
        // 取得 ADC 值
        //--------------------------------------------
        adcValue = ((u16)_sadoh << 8) | _sadol;

        //--------------------------------------------
        // ADC → 電壓
        //
        // 公式：
        // voltage = adc * 5000 / 4095  (0-5V) 老師公式用4096
        //
        // 500 = 5.00V
        //
        // 顯示：
        // 330 => 3.30V
        //--------------------------------------------
                        //Vdd -Gnd  : 4.59V 
        voltage = ((u32)adcValue * 5000) / 4096  ; //5000mV
        //voltage = (adcValue * 5000) / 4096;

        //--------------------------------------------
        // 拆解數字
        //--------------------------------------------

        // 千位
        Buffer[3] = voltage / 1000;
        voltage %= 1000;

        // 百位
        Buffer[2] = voltage / 100;
        voltage %= 100;

        // 十位
        Buffer[1] = voltage /10;
        voltage %= 10;
        

        //--------------------------------------------
        // 1
        //--------------------------------------------
        Buffer[0] = voltage ;
    }
}

//----------------------------------------------------
// Timer ISR
//----------------------------------------------------
DEFINE_ISR(ISR_TB0,0x24)
{
    //------------------------------------------------
    // 關閉七段避免鬼影
    //------------------------------------------------
    SEGPort = 0;

    //------------------------------------------------
    // 位選
    //------------------------------------------------
    ScanPort = ScanCode;

    //------------------------------------------------
    // 顯示數字
    //------------------------------------------------
    SEGPort = SEG_TAB[*ptr];

    //------------------------------------------------
//     | 小數點位置     | 結果    |
//   | --------- | ----- |
//   | Buffer[3] | 3.300 |
//   | Buffer[2] | 33.00 |
//   | Buffer[1] | 330.0 |
//   | Buffer[0] | 3300. |

   
    // https://chatgpt.com/s/m_6a1e45b140d88191a4ff06bdedbdccb7
    //------------------------------------------------
    if(ptr == &Buffer[3])      //4.999 再 
    {
        SEGPort |= 0x80;
    }

    //------------------------------------------------
    // 下一位
    //------------------------------------------------
    ptr++;

    //------------------------------------------------
    // 掃描碼左移
    //------------------------------------------------
    GCC_RL(ScanCode);

    //------------------------------------------------
    // 掃完四位
    //------------------------------------------------
    if(ScanCode == 0x10)
    {
        ScanCode = 0x01;
        ptr = Buffer;
    }
}