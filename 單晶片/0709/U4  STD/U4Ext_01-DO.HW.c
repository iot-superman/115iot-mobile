//=========================================================
// PROGRAM : U4EXT_02.c
// FUNCTION: 4x4 Matrix Keypad + Buzzer Piano Demo
// MCU     : HT66F2390
// AUTHOR  : ChatGPT (依老師教材重新整理)
//=========================================================

#include "HT66F2390.h"
#include "MyType.h"

//---------------------------------------------------------
// 蜂鳴器設定
//---------------------------------------------------------
#define pSPK        _pd6
#define pSPKC       _pdc6

//---------------------------------------------------------
// Matrix KeyPad 設定
//---------------------------------------------------------
#define KeyPort     _pc
#define KeyPortC    _pcc
#define KeyPortPU   _pcpu

//---------------------------------------------------------
// 計算 Pitch 常數
//---------------------------------------------------------
#define M1 1000000

//---------------------------------------------------------
// Function Prototype
//---------------------------------------------------------
void PAUSE(u8 i);
u8 ScanKey(void);

//---------------------------------------------------------
// 音高表 (16 個音)
//---------------------------------------------------------
//---------------------------------------------------------
// 音高表 (16 個音) - 使用浮点数精确计算
//---------------------------------------------------------
const u8 TAB_Pitch[] =
{
    (u8)(M1/(523.0*2*10)),      // Do
    (u8)(M1/(587.0*2*10)),      // Re
    (u8)(M1/(659.0*2*10)),      // Mi
    (u8)(M1/(698.0*2*10)),      // Fa
    (u8)(M1/(785.0*2*10)),      // Sol
    (u8)(M1/(880.0*2*10)),      // La
    (u8)(M1/(988.0*2*10)),      // Si
    (u8)(M1/(1046.0*2*10)),     // 高Do
    (u8)(M1/(1175.0*2*10)),     // 高Re
    (u8)(M1/(1318.0*2*10)),     // 高Mi
    (u8)(M1/(1397.0*2*10)),     // 高Fa
    (u8)(M1/(1568.0*2*10)),     // 高Sol
    (u8)(M1/(1760.0*2*10)),     // 高La
    (u8)(M1/(1976.0*2*10)),     // 高Si
    (u8)(M1/(2093.0*2*10)),     // 更高Do
    (u8)(M1/(2349.0*2*10))      // 更高Re
};

//---------------------------------------------------------
// 每個音播放長度
//---------------------------------------------------------
//---------------------------------------------------------
// 每個音播放長度
//---------------------------------------------------------
const u16 TAB_Duration[] =
{
    (u16)(523.0/2),
    (u16)(587.0/2),
    (u16)(659.0/2),
    (u16)(698.0/2),
    (u16)(785.0/2),
    (u16)(880.0/2),
    (u16)(988.0/2),
    (u16)(1046.0/2),
    (u16)(1175.0/2),
    (u16)(1318.0/2),
    (u16)(1397.0/2),
    (u16)(1568.0/2),
    (u16)(1760.0/2),
    (u16)(1976.0/2),
    (u16)(2093.0/2),
    (u16)(2349.0/2)
};

//=========================================================
// 主程式
//=========================================================
void main()
{
    u8 Key;

    // 關閉 WatchDog
    _wdtc = 0b10101111;

    // PD6 設定為輸出
    pSPKC = 0;
	_sledc1^=(3<<6);							//Source Current Control (Level 0/3)
    while(1)
    {
        //-------------------------------------------------
        // 掃描鍵盤
        //-------------------------------------------------
        Key = ScanKey();

        //-------------------------------------------------
        // Key0~Key15 才播放
        //-------------------------------------------------
        if(Key < 16)
        {
            //-------------------------------------------------
            // 按住就一直叫
            //-------------------------------------------------
            while(Key < 16)
            {
                pSPK = !pSPK;

                PAUSE(TAB_Pitch[Key]);

                // 每半週期重新掃描
                Key = ScanKey();
            }

            // 放開按鍵後關閉輸出
            pSPK = 0;
        }
        
    }
}

//=========================================================
// 延遲函式
//=========================================================
void PAUSE(u8 i)
{
    u8 j;

    // 每次 GCC_DELAY(20) 約為 10us
    // i 越大 → 延遲越長 → 音越低
    for(j=0; j<i; j++)
    {
        GCC_DELAY(20);
    }
}

//=========================================================
// 4×4 Matrix KeyPad 掃描
//
// 回傳值
// 0~15 : 按鍵
// 16   : 沒按任何按鍵
//=========================================================
u8 ScanKey(void)
{
    u8 i;
    u8 key = 0;

    //-----------------------------------------------------
    // PC7~PC4：Input
    // PC3~PC0：Output
    //-----------------------------------------------------
    KeyPortC = 0xF0;

    //-----------------------------------------------------
    // 啟用上拉電阻
    //-----------------------------------------------------
    KeyPortPU = 0xF0;

    //-----------------------------------------------------
    // 第一列輸出為 Low
    //-----------------------------------------------------
    KeyPort = 0b11111110;

    //-----------------------------------------------------
    // 掃描四列
    //-----------------------------------------------------
    for(i=0; i<4; i++)
    {
        //-----------------------------------------
        // Row0
        //-----------------------------------------
        if(!(KeyPort & (1<<4)))
            break;
        key++;

        //-----------------------------------------
        // Row1
        //-----------------------------------------
        if(!(KeyPort & (1<<5)))
            break;
        key++;

        //-----------------------------------------
        // Row2
        //-----------------------------------------
        if(!(KeyPort & (1<<6)))
            break;
        key++;

        //-----------------------------------------
        // Row3
        //-----------------------------------------
        if(!(KeyPort & (1<<7)))
            break;
        key++;

        //-----------------------------------------
        // 下一列
        //-----------------------------------------
        KeyPort <<= 1;
        KeyPort |= 0x01;
    }

    return key;
}

